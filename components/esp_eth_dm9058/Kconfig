## components/esp_eth_dm9058/Kconfig
```kconfig
menu "ESP Ethernet DM9058"
    depends on ETH_USE_SPI_ETHERNET

    config ETH_SPI_ETHERNET_DM9058
        bool "Use DM9058"
        help
            DM9058 is a fast Ethernet controller with an SPI interface.
            It's also integrated with a 10/100M PHY and MAC.
            Select this to enable DM9058 driver.

    config ETH_DM9058_PTP_TWO_STEP_MODE
        bool "DM9058 PTP two-step timestamp mode"
        depends on ETH_SPI_ETHERNET_DM9058
        default y
        help
            If enabled, the DM9058 hardware captures TX timestamps for software
            to read and embed in a separate FOLLOW_UP message (two-step mode).
            If disabled, the hardware inserts the timestamp directly into the
            SYNC packet at transmission time (one-step mode).
            This setting must match the PTP daemon's NETUTILS_PTPD_TWOSTEP_SYNC
            configuration to ensure correct PTP synchronization behavior.

    config ETH_DM9058_PTP_TRANSPORT_IEEE_802_1AS
        bool "DM9058 PTP transport = IEEE 802.1AS (gPTP)"
        depends on ETH_SPI_ETHERNET_DM9058
        default n
        help
            Select IEEE 802.1AS (gPTP) as the DM9058 PTP transport.
            When disabled the transport is IEEE 802.3 (1588 default L2 profile).
            This setting must match the PTP daemon's NETUTILS_PTPD_IEEE_802_1AS
            so the hardware filter and protocol profile agree.

endmenu
```

## examples/common_components/dm9058_eth_connect/Kconfig.projbuild
```kconfig
menu "DM9058 Ethernet Configuration"

    orsource "$IDF_PATH/examples/common_components/env_caps/$IDF_TARGET/Kconfig.env_caps"

    config EXAMPLE_DM9058_ENABLE
        bool "Enable DM9058 SPI Ethernet"
        default n
        select ETH_USE_SPI_ETHERNET
        select ETH_SPI_ETHERNET_DM9058
        help
            Initialize DM9058 SPI Ethernet via the dedicated dm9058_eth_connect
            component. This is independent from protocol_examples_common's
            eth_connect.c so the upstream file stays untouched.

    if EXAMPLE_DM9058_ENABLE

        config EXAMPLE_DM9058_SPI_HOST
            int "SPI host (0..2)"
            range 0 2
            default 1
            help
                Set the SPI host (peripheral) used by DM9058.
                0 = SPI1_HOST, 1 = SPI2_HOST, 2 = SPI3_HOST.

        config EXAMPLE_DM9058_SPI_SCLK_GPIO
            int "SPI SCLK GPIO"
            range ENV_GPIO_RANGE_MIN ENV_GPIO_OUT_RANGE_MAX
            default 16
            help
                GPIO used for SPI SCLK.

        config EXAMPLE_DM9058_SPI_MOSI_GPIO
            int "SPI MOSI GPIO"
            range ENV_GPIO_RANGE_MIN ENV_GPIO_OUT_RANGE_MAX
            default 17
            help
                GPIO used for SPI MOSI.

        config EXAMPLE_DM9058_SPI_MISO_GPIO
            int "SPI MISO GPIO"
            range ENV_GPIO_RANGE_MIN ENV_GPIO_IN_RANGE_MAX
            default 18
            help
                GPIO used for SPI MISO.

        config EXAMPLE_DM9058_SPI_CS_GPIO
            int "SPI CS GPIO"
            range ENV_GPIO_RANGE_MIN ENV_GPIO_OUT_RANGE_MAX
            default 15
            help
                GPIO used for SPI chip-select.

        config EXAMPLE_DM9058_SPI_INT_GPIO
            int "INT GPIO (-1 to use polling)"
            range -1 ENV_GPIO_IN_RANGE_MAX
            default 8
            help
                GPIO used for the DM9058 interrupt line. Set to -1 to use
                polling mode instead of interrupts.

        config EXAMPLE_DM9058_SPI_POLL_MS
            int "Polling period (ms)"
            depends on EXAMPLE_DM9058_SPI_INT_GPIO < 0
            default 10
            help
                Polling interval used when INT GPIO is disabled.

        config EXAMPLE_DM9058_SPI_CLOCK_MHZ
            int "SPI clock (MHz)"
            range 5 80
            default 20
            help
                SPI clock speed in MHz.

        config EXAMPLE_DM9058_PHY_RST_GPIO
            int "PHY reset GPIO (-1 to disable)"
            range -1 ENV_GPIO_OUT_RANGE_MAX
            default -1
            help
                GPIO used to hardware-reset the PHY. Set to -1 to disable.

        config EXAMPLE_DM9058_PHY_ADDR
            int "PHY address"
            range 0 31
            default 1
            help
                PHY address per board schematic.

        config EXAMPLE_DM9058_ENABLE_PTP
            bool "Enable IEEE 1588 PTP support"
            default n
            help
                When enabled, dm9058_ethernet_connect() also calls
                esp_eth_clock_init() so upper layers (e.g. ptpd) can read
                DM9058 hardware timestamps via the esp_eth_time component.

        choice EXAMPLE_DM9058_PTP_TRANSPORT
            prompt "PTP transport"
            depends on EXAMPLE_DM9058_ENABLE_PTP
            default EXAMPLE_DM9058_PTP_TRANSPORT_802_3
            help
                Select the PTP transport that matches your network.

            config EXAMPLE_DM9058_PTP_TRANSPORT_802_3
                bool "IEEE 802.3 (L2)"
            config EXAMPLE_DM9058_PTP_TRANSPORT_802_1AS
                bool "IEEE 802.1AS"
            config EXAMPLE_DM9058_PTP_TRANSPORT_UDP_V4
                bool "UDP / IPv4"
            config EXAMPLE_DM9058_PTP_TRANSPORT_UDP_V6
                bool "UDP / IPv6"
        endchoice

    endif # EXAMPLE_DM9058_ENABLE

endmenu
```

## examples/ethernet/dm9058_ptp/sdkconfig.defaults
```kconfig
# CONFIG_IDF_TARGET="esp32p4"
CONFIG_IDF_TARGET="esp32s3"
# CONFIG_IDF_TARGET="esp32c6"

#
# ESP NETIF Adapter
#
CONFIG_ESP_NETIF_IP_LOST_TIMER_INTERVAL=120
# CONFIG_ESP_NETIF_PROVIDE_CUSTOM_IMPLEMENTATION is not set
CONFIG_ESP_NETIF_TCPIP_LWIP=y
# CONFIG_ESP_NETIF_LOOPBACK is not set
CONFIG_ESP_NETIF_USES_TCPIP_WITH_BSD_API=y
CONFIG_ESP_NETIF_REPORT_DATA_TRAFFIC=y
# CONFIG_ESP_NETIF_RECEIVE_REPORT_ERRORS is not set
CONFIG_ESP_NETIF_L2_TAP=y
CONFIG_ESP_NETIF_L2_TAP_MAX_FDS=5
CONFIG_ESP_NETIF_L2_TAP_RX_QUEUE_SIZE=20
# CONFIG_ESP_NETIF_BRIDGE_EN is not set
# CONFIG_ESP_NETIF_SET_DNS_PER_DEFAULT_NETIF is not set
# end of ESP NETIF Adapter

CONFIG_EXAMPLE_USE_INTERNAL_ETHERNET=y
CONFIG_EXAMPLE_ETH_PHY_IP101=y


#
# Ethernet
#
CONFIG_ETH_ENABLED=y
CONFIG_ETH_USE_SPI_ETHERNET=y
# CONFIG_ETH_SPI_ETHERNET_DM9051 is not set
CONFIG_ETH_SPI_ETHERNET_DM9058=y
CONFIG_ETH_DM9058_PTP_TWO_STEP_MODE=y
CONFIG_ETH_DM9058_PTP_TRANSPORT_IEEE_802_1AS=y
# CONFIG_ETH_SPI_ETHERNET_W5500 is not set
# CONFIG_ETH_SPI_ETHERNET_KSZ8851SNL is not set
# CONFIG_ETH_USE_OPENETH is not set
CONFIG_ETH_TRANSMIT_MUTEX=y
# end of Ethernet


#
# Example Configuration
#
CONFIG_ENV_GPIO_RANGE_MIN=0
CONFIG_ENV_GPIO_RANGE_MAX=48
CONFIG_ENV_GPIO_IN_RANGE_MAX=48
CONFIG_ENV_GPIO_OUT_RANGE_MAX=48
CONFIG_EXAMPLE_PTP_PULSE_GPIO=20
CONFIG_EXAMPLE_PTP_PULSE_WIDTH_NS=500000000
# end of Example Configuration

#
# PTP Daemon Configuration
#
CONFIG_NETUTILS_PTPD=y
CONFIG_NETUTILS_PTPD_CLIENT=y
CONFIG_NETUTILS_PTPD_SERVER=y
CONFIG_NETUTILS_PTPD_STACKSIZE=4096
CONFIG_NETUTILS_PTPD_SERVERPRIO=100
CONFIG_NETUTILS_PTPD_DOMAIN=0
CONFIG_NETUTILS_PTPD_IEEE_802_1AS=y
CONFIG_NETUTILS_PTPD_PDELAYREQ_INTERVAL_MS=250
CONFIG_NETUTILS_PTPD_PRIORITY1=128
CONFIG_NETUTILS_PTPD_PRIORITY2=128
CONFIG_NETUTILS_PTPD_CLASS=248
CONFIG_NETUTILS_PTPD_ACCURACY=254
CONFIG_NETUTILS_PTPD_CLOCKSOURCE=160
CONFIG_NETUTILS_PTPD_SYNC_INTERVAL_MSEC=1000
CONFIG_NETUTILS_PTPD_ANNOUNCE_INTERVAL_MSEC=10000
CONFIG_NETUTILS_PTPD_TWOSTEP_SYNC=y
CONFIG_NETUTILS_PTPD_DELAYRESP_INTERVAL=4
CONFIG_NETUTILS_PTPD_TIMEOUT_MS=60000
CONFIG_NETUTILS_PTPD_SETTIME_THRESHOLD_MS=1000
CONFIG_NETUTILS_PTPD_SEND_DELAYREQ=y
CONFIG_NETUTILS_PTPD_MAX_PATH_DELAY_NS=100000
CONFIG_NETUTILS_PTPD_DELAYREQ_AVGCOUNT=100
CONFIG_NETUTILS_PTPD_PATH_DELAY_STABILITY_NS=500
# end of PTP Daemon Configuration



#
# Example Ethernet Configuration
#
CONFIG_EXAMPLE_USE_SPI_ETHERNET=y
# (menuconfig, SPI_CONFIGURATIONS)
# CONFIG_EXAMPLE_USE_DM9051 is not set
CONFIG_EXAMPLE_USE_DM9058=y
# CONFIG_EXAMPLE_USE_KSZ8851SNL is not set
# CONFIG_EXAMPLE_USE_W5500 is not set
CONFIG_EXAMPLE_ETH_SPI_HOST=1
CONFIG_EXAMPLE_ETH_SPI_SCLK_GPIO=16
CONFIG_EXAMPLE_ETH_SPI_MOSI_GPIO=17
CONFIG_EXAMPLE_ETH_SPI_MISO_GPIO=18
CONFIG_EXAMPLE_ETH_SPI_CLOCK_MHZ=20
CONFIG_EXAMPLE_ETH_SPI_CS0_GPIO=15
CONFIG_EXAMPLE_ETH_SPI_INT0_GPIO=8
CONFIG_EXAMPLE_ETH_SPI_POLLING0_MS=0
CONFIG_EXAMPLE_ETH_SPI_PHY_RST0_GPIO=-1
CONFIG_EXAMPLE_ETH_SPI_PHY_ADDR0=1
# end of Example Ethernet Configuration
```

## examples/ethernet/ptp/components/gptp/Kconfig.projbuild
```kconfig
menu "gPTP (IEEE 802.1AS) Configuration"

    config GPTP_ENABLED
        bool "Enable gPTP daemon"
        default n
        help
            Enable the IEEE 802.1AS (gPTP) generalized Precision Time Protocol
            daemon. Uses L2TAP raw Ethernet transport and the esp_eth PTP
            hardware clock HAL.

    if GPTP_ENABLED

    config GPTP_IFACE_NAME
        string "Ethernet interface name"
        default "ETH_DEF"
        help
            Name of the Ethernet interface to bind the gPTP daemon to.
            Corresponds to the L2TAP interface device name set via
            L2TAP_S_INTF_DEVICE ioctl.

    config GPTP_DOMAIN_NUMBER
        int "PTP domain number"
        default 0
        range 0 127
        help
            IEEE 1588 domain number. Must match on all nodes in the same
            802.1AS domain. gPTP typically uses domain 0.

    config GPTP_PRIORITY1
        int "Priority1 (BMCA)"
        default 128
        range 0 255
        help
            Priority1 field used by the Best Master Clock Algorithm (BMCA).
            Lower values are preferred. A grandmaster should be given a value
            lower than the default 128 (e.g. 50).

    config GPTP_PRIORITY2
        int "Priority2 (BMCA tie-breaker)"
        default 128
        range 0 255
        help
            Priority2 is the secondary tie-breaker after priority1, clockClass
            and clockAccuracy. Lower values are preferred.

    config GPTP_CLOCK_CLASS
        int "Clock class"
        default 248
        range 0 255
        help
            Clock class for the local clock.
              135 = primary reference clock (GPS-locked, etc.)
              248 = default (no external reference / slave-capable)
              255 = slave-only

    config GPTP_SLAVE_ONLY
        bool "Slave-only mode"
        default n
        help
            When enabled, this node will never become a grandmaster. It will
            always synchronise to an external master. Equivalent to setting
            clock class 255 and priority1=255.

    config GPTP_TWO_STEP
        bool "Two-step clock mode"
        default n
        help
            Enable two-step operation: the precise TX timestamp is carried in
            a FollowUp / PDelayRespFollowUp message rather than embedded in the
            original event message. Required when the hardware cannot insert the
            timestamp into the frame on-the-fly. Disable for one-step operation
            (802.1AS default).

    config GPTP_SYNC_INTERVAL
        int "Sync interval (log2 seconds)"
        default -3
        range -7 0
        help
            log2 of the Sync message interval in seconds.
              -3 = 125 ms  (802.1AS default)
              -2 = 250 ms
              -1 = 500 ms
               0 = 1 s

    config GPTP_ANNOUNCE_INTERVAL
        int "Announce interval (log2 seconds)"
        default 0
        range -3 4
        help
            log2 of the Announce message interval in seconds.
              0 = 1 s  (802.1AS default)

    config GPTP_TASK_STACK_SIZE
        int "Task stack size (bytes)"
        default 8192
        range 4096 32768
        help
            FreeRTOS stack size for the gPTP daemon task.

    config GPTP_TASK_PRIORITY
        int "Task priority"
        default 10
        range 1 24
        help
            FreeRTOS task priority for the gPTP daemon. Should be higher than
            the application task but lower than time-critical ISR-deferred tasks.

    config GPTP_LOG_VERBOSE
        bool "Enable verbose (DEBUG/VERBOSE) logging"
        default n
        help
            When enabled, DBGV / DBGVV macros emit ESP_LOGV / ESP_LOGD output.
            Very noisy – only useful when debugging the state machine or
            message timing.

    endif # GPTP_ENABLED

endmenu
```
