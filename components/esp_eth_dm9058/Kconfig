## examples/ethernet/ptp/components/ptpd/Kconfig.projbuild
```kconfig
#
# For a description of the syntax of this configuration file,
# see the file kconfig-language.txt in the NuttX tools repository.
#
menu "PTP Daemon Configuration"

    config NETUTILS_PTPD
        bool "PTPD client/server"
        default y
    #depends on NET_IPv4
    #depends on NET_IGMP
    #depends on NET_UDP
        help
            Build a minimal implementation of IEEE-1588 precision time protocol.
            Uses system gettimeofday() and adjtime() calls to synchronize clock
            with a master clock through network, or to provide a master clock to
            other systems.

    if NETUTILS_PTPD

        config NETUTILS_PTPD_GPTP_PROFILE
            bool "Enable full 802.1AS gPTP profile"
            default n
            help
                When enabled, all PTP messages (Sync, Announce, Follow_Up, Pdelay_*)
                are sent to the 802.1AS multicast MAC 01:80:C2:00:00:0E and the
                transportSpecific field is set to 0x1 (gPTP SdoId).
                When disabled, only Pdelay messages use the gPTP MAC; Sync/Announce
                continue to use 01:1B:19:00:00:00 for backward compatibility.

        config NETUTILS_PTPD_DEBUG
            bool "Enable PTP debug messages"
            default n
            depends on DEBUG_INFO
            help
                Enable PTP debug messages even if CONFIG_DEBUG_NET_INFO is not enabled.

        config NETUTILS_PTPD_CLIENT
            bool "Enable client support"
            default y
            help
                Act as a PTP client, synchronizing the NuttX clock to a remote master
                clock.

        config NETUTILS_PTPD_SERVER
            bool "Enable server support"
            default n
            help
                Act as a PTP server, providing NuttX clock time to other systems.

                Both server and client can be simultaneously enabled. NuttX will then
                synchronize to a higher priority master clock, or act as a master
                clock itself if it has the highest priority.
                Refer to Best Master Clock algorithm in IEEE-1588 for details.

        config NETUTILS_PTPD_STACKSIZE
            int "PTP daemon stack stack size"
            default 4096 # DEFAULT_TASK_STACKSIZE

        config NETUTILS_PTPD_SERVERPRIO
            int "PTP daemon priority"
            default 100

        config NETUTILS_PTPD_DOMAIN
            int    "PTP domain selection"
            default 0
            range 0 127
            help
                Set PTP domain to participate in. Default domain is 0, other domains
                can be used to isolate reference clocks from each other.

        if NETUTILS_PTPD_SERVER

            config NETUTILS_PTPD_PRIORITY1
                int "PTP server priority1"
                default 128
                range 0 255
                help
                    Set clock priority to announce when acting as a PTP server.
                    Lower value is higher priority.
                    A higher priority1 clock will be selected without regard to announced
                    clock quality fields.
                    Refer to Best Master Clock algorithm in IEEE-1588 for details.

            config NETUTILS_PTPD_PRIORITY2
                int "PTP server priority2"
                default 128
                range 0 255
                help
                    Set clock subpriority to announce when acting as a PTP server.
                    This will distinguish between two clocks that are equivalent in
                    priority1, class and accuracy values.
                    Lower value is higher priority.

            config NETUTILS_PTPD_CLASS
                int "PTP server class"
                default 248
                range 0 255
                help
                    Set master clock class to announce when acting as a PTP server.
                    Lower value means higher quality clock source.
                    248 is the default for unknown class.

            config NETUTILS_PTPD_ACCURACY
                int "PTP server accuracy"
                default 254
                range 0 255
                help
                    Set master clock accuracy to announce when acting as a PTP server.
                    Logarithmic scale is defined in IEEE-1588:
                    32: +-  25 ns
                    33: +- 100 ns
                    34: +- 250 ns
                    35: +-   1 us
                    36: +-   2.5 us
                    37: +-  10 us
                    38: +-  25 us
                    39: +- 100 us
                    40: +- 250 us
                    41: +-   1 ms
                    42: +-   2.5 ms
                    43: +-  10 ms
                    44: +-  25 ms
                    45: +- 100 ms
                    46: +- 250 ms
                    47: +-   1 s
                    48: +-  10 s
                    49: +-  more than 10 s
                    254: Unknown

            config NETUTILS_PTPD_CLOCKSOURCE
                int "PTP server clock source type"
                default 160
                range 0 255
                help
                    Set clock source type to announce when acting as a PTP server.
                    Common values:
                    32: GPS
                    64: PTP
                    80: NTP
                    144: Other
                    160: Internal oscillator

            config NETUTILS_PTPD_SYNC_INTERVAL_MSEC
                int "PTP server sync transmit interval (ms)"
                default 1000
                help
                    How often to transmit sync packets in server mode.

            config NETUTILS_PTPD_ANNOUNCE_INTERVAL_MSEC
                int "PTP server announce transmit interval (ms)"
                default 10000
                help
                    How often to transmit announce packets in server mode.

            config NETUTILS_PTPD_TWOSTEP_SYNC
                bool "PTP server sends two-step synchronization packets"
                default ETH_DM9058_PTP_TWO_STEP_MODE if ETH_SPI_ETHERNET_DM9058
                default y
                help
                    If enabled, sends a follow-up packet after every sync packet.
                    This helps compensate for the time taken to initiate the transmission.
                    When using DM9058, this must match ETH_DM9058_PTP_TWO_STEP_MODE
                    so that the hardware timestamp mode aligns with the protocol behavior.

            config NETUTILS_PTPD_DELAYRESP_INTERVAL
                int "PTP server suggested interval of delay requests"
                range 0 255
                default 4
                help
                    When responding to a delay request, the server can inform the client
                    how often it should test path delay. This is done using header field
                    logMessageInterval. The delay will be 2^N seconds.

                    Default value 4 results in 16 second interval.

        endif # NETUTILS_PTPD_SERVER

        if NETUTILS_PTPD_CLIENT

            choice NETUTILS_PTPD_DELAY_MECHANISM
                prompt "PTP delay measurement mechanism"
                default NETUTILS_PTPD_MECHANISM_P2P
                help
                    Select the delay measurement method. P2P (Peer-to-Peer) is
                    mandatory for IEEE 802.1AS (gPTP). E2E uses the original
                    Delay_Req / Delay_Resp mechanism from IEEE 1588.

            config NETUTILS_PTPD_MECHANISM_E2E
                bool "E2E (End-to-End, IEEE 1588 Delay_Req/Resp)"
                help
                    Use Delay_Req / Delay_Resp for path delay measurement.

            config NETUTILS_PTPD_MECHANISM_P2P
                bool "P2P (Peer-to-Peer, required by IEEE 802.1AS gPTP)"
                help
                    Use Pdelay_Req / Pdelay_Resp / Pdelay_Resp_Follow_Up for
                    peer link delay measurement. Mandatory for 802.1AS compliance.

            endchoice

            config NETUTILS_PTPD_PDELAY_INTERVAL_MSEC
                int "gPTP Pdelay request interval (ms)"
                default 250
                depends on NETUTILS_PTPD_MECHANISM_P2P
                help
                    Interval between Pdelay_Req transmissions in milliseconds.
                    IEEE 802.1AS default is 250 ms (logPdelayReqInterval = -2).

            config NETUTILS_PTPD_PDELAY_AVGCOUNT
                int "Peer delay averaging count"
                default 16
                depends on NETUTILS_PTPD_MECHANISM_P2P
                help
                    Number of peer delay samples to average. Range 8-32 recommended.

            config NETUTILS_PTPD_MAX_PEER_DELAY_NS
                int "Maximum acceptable peer delay (ns)"
                default 100000
                depends on NETUTILS_PTPD_MECHANISM_P2P
                help
                    Peer delay samples outside this range are discarded as outliers.
                    100 us is appropriate for a local switched Ethernet segment.

            config NETUTILS_PTPD_TIMEOUT_MS
                int "PTP client timeout for changing clock source (ms)"
                default 60000
                help
                    If no packets are being received from currently chosen clock source,
                    fall back to next best clock source after this many seconds.

            config NETUTILS_PTPD_SETTIME_THRESHOLD_MS
                int "PTP client threshold for changing system time (ms)"
                default 1000
                help
                    If difference between local and remote clock exceeds this threshold,
                    time is reset with settimeofday() instead of changing the rate with
                    adjtime().

        # Commented options not used by ESP_PTP
        #config NETUTILS_PTPD_MULTICAST_TIMEOUT_MS
        #    int "PTP client timeout to rejoin multicast group (ms)"
        #    default 30000 #esp32
        #    default 0
        #    help
        #        If no PTP multicast packets are being received, attempt to rejoin the
        #        multicast group. This can be necessary if network topology changes, or
        #        depending on hardware, after some error recovery events.
        #        Set to 0 to disable.

        #config NETUTILS_PTPD_DRIFT_AVERAGE_S
        #    int "PTP client clock drift rate averaging time (s)"
        #    default 600
        #    range 10 86400
        #    help
        #        Clock drift rate is averaged over this time pediod. Larger value
        #        gives more stable estimate but reacts slower to crystal oscillator speed
        #        changes (such as caused by temperature changes).

            config NETUTILS_PTPD_SEND_DELAYREQ
                bool "PTP client enable delay requests (E2E)"
                default n
                depends on NETUTILS_PTPD_MECHANISM_E2E
                help
                    If enabled, sends delay request messages to measure the network delay
                    to server. If disabled, assumes zero delay.
                    Only applies to E2E mode; P2P mode uses Pdelay automatically.

            if NETUTILS_PTPD_SEND_DELAYREQ

                config NETUTILS_PTPD_MAX_PATH_DELAY_NS
                    int "PTP client maximum path delay (ns)"
                    default 100000
                    range 1 1000000000
                    help
                        Measured path delay longer than this is ignored. Delay requests are
                        also not transmitted until clock synchronization is better than this.

                config NETUTILS_PTPD_DELAYREQ_AVGCOUNT
                    int "PTP client path delay averaging count"
                    default 100
                    help
                        Measured path delay is averaged over this many samples.

                config NETUTILS_PTPD_PATH_DELAY_STABILITY_NS
                    int "PTP client send delay request when clock stability (ns)"
                    default 250
                    help
                        Sends path delay request only once the internal clock is stable and skews only
                        in defined interval.

            endif # NETUTILS_PTPD_SEND_DELAYREQ

        endif # NETUTILS_PTPD_CLIENT

    endif # NETUTILS_PTPD

endmenu # PTP Daemon Configuration
```

## examples/ethernet/ptp/main/Kconfig.projbuild
```kconfig
menu "Example Configuration"

    orsource "$IDF_PATH/examples/common_components/env_caps/$IDF_TARGET/Kconfig.env_caps"

    choice EXAMPLE_PTP_TRANSPORT
        prompt "PTP transport type"
        default EXAMPLE_PTP_TRANSPORT_IEEE_802_3
        help
            Select the PTP transport type.
            IEEE 802.3: PTP over raw Ethernet (EtherType 0x88F7).
            UDP IPv4: PTP over UDP/IPv4 (multicast 224.0.1.129, ports 319/320).

        config EXAMPLE_PTP_TRANSPORT_IEEE_802_3
            bool "IEEE 802.3 (Layer 2 Ethernet)"

        config EXAMPLE_PTP_TRANSPORT_UDP_IPV4
            bool "UDP IPv4"
    endchoice

    config EXAMPLE_PTP_PULSE_GPIO
        int "PPS GPIO number"
        range ENV_GPIO_RANGE_MIN ENV_GPIO_OUT_RANGE_MAX
        default 20
        help
            Set the GPIO number at which the Pulse signal is outputted.

    config EXAMPLE_PTP_PULSE_WIDTH_NS
        int "Pulse width (ns)"
        range 5000 999999999
        default 500000000
        help
            Set pulse width in ns.
            WARNING: Since the new pulse target time is set programmatically in the callback
            function, width accuracy may vary or it may be lost completely when you select
            very short pulse width.

endmenu
```

## examples/ethernet/ptp/sdkconfig.defaults
```kconfig
# CONFIG_IDF_TARGET="esp32p4"
CONFIG_IDF_TARGET="esp32s3"
# CONFIG_IDF_TARGET="esp32c6"

# Transport selection (uncomment one):
# CONFIG_ESP_NETIF_L2_TAP=y    # IEEE 802.3 / EtherType 0x88F7 (L2 raw frame)
CONFIG_ESP_NETIF_L2_TAP is not set  # UDP/IPv4 port 319/320 (default)

CONFIG_EXAMPLE_USE_INTERNAL_ETHERNET=y
CONFIG_EXAMPLE_ETH_PHY_IP101=y

CONFIG_NETUTILS_PTPD=y
CONFIG_NETUTILS_PTPD_CLIENT=y
CONFIG_NETUTILS_PTPD_SERVER=y

CONFIG_ETH_SPI_ETHERNET_DM9058=y

#
# Example Ethernet Configuration
#
CONFIG_EXAMPLE_USE_SPI_ETHERNET=y
# (MANUAL, SPI_CONFIGURATIONS)
CONFIG_EXAMPLE_SPI_ETHERNETS_NUM=1
CONFIG_EXAMPLE_USE_DM9058=y
# CONFIG_EXAMPLE_USE_KSZ8851SNL is not set
# CONFIG_EXAMPLE_USE_W5500 is not set
CONFIG_EXAMPLE_ETH_SPI_HOST=1
CONFIG_EXAMPLE_ETH_SPI_SCLK_GPIO=16
CONFIG_EXAMPLE_ETH_SPI_MOSI_GPIO=17
CONFIG_EXAMPLE_ETH_SPI_MISO_GPIO=18
CONFIG_EXAMPLE_ETH_SPI_CLOCK_MHZ=20
CONFIG_EXAMPLE_ETH_SPI_CS0_GPIO=15
CONFIG_EXAMPLE_ETH_SPI_INT0_GPIO=8
CONFIG_EXAMPLE_ETH_SPI_POLLING0_MS=0
CONFIG_EXAMPLE_ETH_SPI_PHY_RST0_GPIO=-1
CONFIG_EXAMPLE_ETH_SPI_PHY_ADDR0=1
# CONFIG_ESP_MAIN_TASK_STACK_SIZE=8192
# CONFIG_ESP_SYSTEM_EVENT_TASK_STACK_SIZE=8192

# CONFIG_MAIN_TASK_STACK_SIZE=8192
# CONFIG_SYSTEM_EVENT_TASK_STACK_SIZE=4096

CONFIG_NETUTILS_PTPD_SEND_DELAYREQ=y
CONFIG_NETUTILS_PTPD_MAX_PATH_DELAY_NS=100000
CONFIG_NETUTILS_PTPD_DELAYREQ_AVGCOUNT=100
CONFIG_NETUTILS_PTPD_PATH_DELAY_STABILITY_NS=500
# CONFIG_NETUTILS_PTPD_PATH_DELAY_STABILITY_NS=4000
```
